## documents/IT7259/driver/Kconfig
```kconfig
#
# Touchscreen driver configuration
#
if TOUCHSCREEN_MTK_IT7259

config IT7259_FIRMWARE
	string "IT7259 for Mediatek firmware"

config IT7259_CONFIG
	string "IT7259 for Mediatek config"


endif
```
